## conf/layer.conf
```bitbake
# We have a conf and classes directory, add to BBPATH
BBPATH := "${BBPATH}:${LAYERDIR}"

# We have a packages directory, add to BBFILES
BBFILES += "${LAYERDIR}/recipes-*/*/*.bb \
            ${LAYERDIR}/recipes-*/*/*.bbappend"

BBFILE_COLLECTIONS += "meta-casync"
BBFILE_PATTERN_meta-casync = "^${LAYERDIR}/"
BBFILE_PRIORITY_meta-casync = "7"

LAYERVERSION_meta-casync = "1"
LAYERSERIES_COMPAT_meta-casync = "dunfell"
```
